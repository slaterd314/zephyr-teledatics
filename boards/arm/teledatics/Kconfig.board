## boards/arm/teledatics/Kconfig.board
```kconfig
# MIMX8MM EVK board

# Copyright (c) 2020, Manivannan Sadhasivam <mani@kernel.org>
# SPDX-License-Identifier: Apache-2.0

config BOARD_TELEDATICS_IMX8MM
	bool "Teledatics imx8mm board"
	depends on SOC_SERIES_IMX8MM_M4
	select SOC_PART_NUMBER_MIMX8MM6DVTLZ
```

## boards/arm/teledatics_imx8mm/Kconfig.defconfig
```kconfig
# MIMX8MM EVK board defconfig

# Copyright (c) 2020, Manivannan Sadhasivam <mani@kernel.org>
# SPDX-License-Identifier: Apache-2.0

if BOARD_TELEDATICS_IMX8MM

config BOARD
	default "teledatics_imx8mm"

if !XIP
config FLASH_SIZE
	default 0
config FLASH_BASE_ADDRESS
	default 0
endif

endif # BOARD_TELEDATICS_IMX8MM
```
